.include "m8515def.inc" ; include the ATMEGA32 definition file
.ORG 0

.EQU LCD_DPRT = PORTA
.EQU LCD_DDDR = DDRA
.EQU LCD_DPIN = PINA
.EQU LCD_CPRT = PORTD
.EQU LCD_CDDR = DDRD
.EQU LCD_CPIN = PIND
.EQU LCD_RS = 4
.EQU LCD_RW = 5
.EQU LCD_EN = 6

LDI R21, HIGH(RAMEND)
OUT SPH, R21
LDI R21, LOW(RAMEND)
OUT SPL, R21

LDI R21, $FF
OUT LCD_DDDR, R21
OUT LCD_CDDR, R21
CBI LCD_CPRT, LCD_EN
RCALL DELAY_2ms
LDI R16, $38
RCALL CMNDWRT
RCALL DELAY_2ms
LDI R16, $0E
RCALL CMNDWRT
LDI R16, $01
RCALL CMNDWRT
RCALL DELAY_2ms
LDI R16, $06
RCALL CMNDWRT
LDI R16, 'H'
RCALL DATAWRT
LDI R16, 'I'
RCALL DATAWRT

HERE: RJMP HERE


CMNDWRT:

OUT LCD_DPRT, R16
CBI LCD_CPRT, LCD_RS
CBI LCD_CPRT, LCD_RW
SBI LCD_CPRT, LCD_EN
RCALL SDELAY
CBI LCD_CPRT, LCD_EN
RCALL DELAY_100us
RET


DATAWRT:

OUT LCD_DPRT, R16
SBI LCD_CPRT, LCD_RS
CBI LCD_CPRT, LCD_RW
SBI LCD_CPRT, LCD_EN
RCALL SDELAY
CBI LCD_CPRT, LCD_EN
RCALL DELAY_100us
RET


SDELAY:

NOP
NOP
RET

DELAY_100us:

PUSH R17
LDI R17, 60

DR0:

RCALL SDELAY
DEC R17
BRNE DR0

POP R17
RET

DELAY_2ms:

PUSH R17
LDI R17, 20

LDR0:

RCALL DELAY_100us
DEC R17
BRNE LDR0
POP R17
RET
