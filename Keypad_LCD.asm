
.INCLUDE "M8515DEF.INC"
.ORG 0

.EQU LCD_DPRT = PORTA
.EQU LCD_DDDR = DDRA
.EQU LCD_DPIN = PINA
.EQU LCD_CPRT = PORTD
.EQU LCD_CDDR = DDRD
.EQU LCD_CPIN = PIND
.EQU LCD_RS = 4
.EQU LCD_RW = 5
.EQU LCD_EN = 6

.EQU KEY_PORT = PORTC
.EQU KEY_PIN = PINC
.EQU KEY_DDR = DDRC


LDI R16, HIGH(RAMEND)
OUT SPH, R16
LDI R16, LOW(RAMEND)
OUT SPL, R16

    LDI R21, 0xFF
	OUT DDRA, R21
	LDI R20, 0xF0
	OUT KEY_DDR, R20

GROUND_ALL_ROWS:

	LDI R20, 0x0F
	OUT KEY_PORT, R20

WAIT_FOR_RELEASE:

	NOP
	IN R21, KEY_PIN
	ANDI R21, 0x0F
	CPI R21, 0x0F
	BRNE WAIT_FOR_RELEASE

WAIT_FOR_KEY:

	NOP
	IN R21, KEY_PIN
	ANDI R21, 0x0F
	CPI R21, 0x0F
	BREQ WAIT_FOR_KEY
	NOP
	NOP
	NOP
	NOP
	NOP
	NOP

	NOP
	IN R21, KEY_PIN
	ANDI R21, 0x0F
	CPI R21, 0x0F
	BREQ WAIT_FOR_KEY
	
	LDI R21, 0B01111111
	OUT KEY_PORT, R21
	NOP
	
	IN R21, KEY_PIN
	ANDI R21, 0x0F
	CPI R21, 0x0F
	BRNE COL1

	LDI R21, 0B10111111
	OUT KEY_PORT, R21
	NOP
	
	IN R21, KEY_PIN
	ANDI R21, 0x0F
	CPI R21, 0x0F
	BRNE COL2

	LDI R21, 0B11011111
	OUT KEY_PORT, R21
	NOP
	
	IN R21, KEY_PIN
	ANDI R21, 0x0F
	CPI R21, 0x0F
	BRNE COL3

	LDI R21, 0B11101111
	OUT KEY_PORT, R21
	NOP
	
	IN R21, KEY_PIN
	ANDI R21, 0x0F
	CPI R21, 0x0F
	BRNE COL4

COL1:

	LDI ZL, LOW(KCODE0<<1)
	LDI ZH, HIGH(KCODE0<<1)
	RJMP FIND

COL2:

	LDI ZL, LOW(KCODE1<<1)
	LDI ZH, HIGH(KCODE1<<1)
	RJMP FIND

COL3:

	LDI ZL, LOW(KCODE2<<1)
	LDI ZH, HIGH(KCODE2<<1)
	RJMP FIND

COL4:

	LDI ZL, LOW(KCODE3<<1)
	LDI ZH, HIGH(KCODE3<<1)
	RJMP FIND

FIND:

	LSR R21
	BRCC MATCH
	LPM R20, Z+
;	INC R30
	RJMP FIND

MATCH:

	LPM R20, Z
;	OUT PORTA, R20
	RCALL LCD_KEYPAD
	RJMP GROUND_ALL_ROWS

	NOP
	NOP
	NOP
	NOP
	NOP
	RET

LCD_KEYPAD:

LDI R21, $FF
OUT LCD_DDDR, R21
OUT LCD_CDDR, R21
CBI LCD_CPRT, LCD_EN
RCALL DELAY_2ms
LDI R16, $38
RCALL CMNDWRT
RCALL DELAY_2ms
LDI R16, $0E
RCALL CMNDWRT
LDI R16, $01
RCALL CMNDWRT
RCALL DELAY_2ms
LDI R16, $06
RCALL CMNDWRT
;LDI R16, 'H'
;RCALL DATAWRT
;LDI R16, 'I'
RCALL DATAWRT

RET
;HERE: RJMP HERE


CMNDWRT:

OUT LCD_DPRT, R16
CBI LCD_CPRT, LCD_RS
CBI LCD_CPRT, LCD_RW
SBI LCD_CPRT, LCD_EN
RCALL SDELAY
CBI LCD_CPRT, LCD_EN
RCALL DELAY_100us
RET


DATAWRT:

OUT LCD_DPRT, R20
SBI LCD_CPRT, LCD_RS
CBI LCD_CPRT, LCD_RW
SBI LCD_CPRT, LCD_EN
RCALL SDELAY
CBI LCD_CPRT, LCD_EN
RCALL DELAY_100us
RET


SDELAY:

NOP
NOP
RET

DELAY_100us:

PUSH R17
LDI R17, 60

DR0:

RCALL SDELAY
DEC R17
BRNE DR0

POP R17
RET

DELAY_2ms:

PUSH R17
LDI R17, 20

LDR0:

RCALL DELAY_100us
DEC R17
BRNE LDR0
POP R17
RET

.ORG 0x120

KCODE0:	.DB 'D', 'C', 'B', 'A'
KCODE1:	.DB	'E', '9', '6', '3'
KCODE2:	.DB	'0', '8', '5', '2'
KCODE3:	.DB	'F', '7', '4', '1'	
